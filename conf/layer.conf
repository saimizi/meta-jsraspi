## conf/layer.conf
```bitbake
# We have a conf and classes directory, add to BBPATH
BBPATH .= ":${LAYERDIR}"

# We have recipes-* directories, add to BBFILES
BBFILES += "${LAYERDIR}/recipes-*/*/*.bb \
	${LAYERDIR}/recipes-*/*/*.bbappend"

BBFILE_COLLECTIONS += "jsrapi"
BBFILE_PATTERN_jsrapi = "^${LAYERDIR}/"
BBFILE_PRIORITY_jsrapi = "11"

LAYERSERIES_COMPAT_jsrapi = "sumo"
```
